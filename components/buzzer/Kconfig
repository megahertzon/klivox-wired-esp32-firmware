## components/buzzer/Kconfig
```kconfig
menu "Klivox active buzzer"

    config KLIVOX_BUZZER_GPIO
        int "NPN transistor base GPIO (through series resistor)"
        range 0 48
        default 25
        help
            Active-high output for an externally powered active buzzer through
            an NPN transistor. Default GPIO25; GPIO18 and GPIO27 are used by
            DS18B20 and IR in Klivox Wired. A base-to-ground resistor keeps the
            transistor off during reset, before the application starts.

    config KLIVOX_BUZZER_PULSE_MS
        int "IR capture beep duration (ms)"
        range 50 1000
        default 80
        help
            Non-blocking one-shot pulse. Captures received during an active
            pulse are coalesced: they do not queue or extend the sound.

endmenu
```

## components/digital_inputs/Kconfig
```kconfig
menu "Klivox digital inputs"

    config KLIVOX_CONTACT_1_GPIO
        int "NC contact 1 GPIO (HIGH = open)"
        range 0 48
        default 32

    config KLIVOX_CONTACT_2_GPIO
        int "NC contact 2 GPIO (HIGH = open)"
        range 0 48
        default 26

    config KLIVOX_CONTACT_DEBOUNCE_MS
        int "NC contacts debounce (ms)"
        range 10 1000
        default 50

    config KLIVOX_BUTTON_POWER_GPIO
        int "NO power toggle button GPIO (LOW = pressed)"
        range 0 48
        default 19

    config KLIVOX_BUTTON_DEBOUNCE_MS
        int "NO buttons debounce (ms)"
        range 10 1000
        default 50
        help
            Connect each dry contact/button between its input and GND.
            Use a separate external 10 kOhm pull-up to 3.3 V per input.
            Debounce windows are independent. GPIOs must be free and distinct.

endmenu
```

## components/ir_receiver/Kconfig
```kconfig
menu "Klivox IR receiver"

    config KLIVOX_IR_RX_GPIO
        int "VS1838B OUT GPIO"
        range 0 48
        default 27
        help
            Choose an available input GPIO. Klivox Wired uses GPIO27 by default;
            GPIO18 is reserved for the DS18B20. Power the receiver from 3.3 V.

    config KLIVOX_IR_RX_BUFFER_SIZE
        int "Capture buffer entries"
        range 1024 16384
        default 4096
        help
            Two buffers are allocated, using about four bytes per entry in
            total. Larger values need more heap, especially with Wi-Fi/BLE.

    config KLIVOX_IR_RX_TIMEOUT_MS
        int "End-of-message silence (ms)"
        range 15 130
        default 50
        help
            AC remotes can send multiple sections. Increase this if a single
            command is split into incomplete frames, as in on_off_light.

    config KLIVOX_IR_DUMP_RAW
        bool "Log raw timings for each received frame"
        default y
        help
            Prints durations in microseconds, starting with a mark. Long
            serial dumps can lose subsequent frames; press one button at a time.

endmenu
```

## components/status_led_manager/Kconfig
```kconfig
menu "Klivox RGB status LED"
    config KLIVOX_LED_ANODE_GPIO
        int "Common anode GPIO (held HIGH after initialization)"
        range 0 33
        default 13
        help
            Constant HIGH output, enabled after the RGB channels are off.
            Size the channel resistors for the total GPIO source current.
    config KLIVOX_LED_RED_GPIO
        int "Red GPIO"
        range 0 33
        default 21
    config KLIVOX_LED_GREEN_GPIO
        int "Green GPIO"
        range 0 33
        default 22
    config KLIVOX_LED_BLUE_GPIO
        int "Blue GPIO"
        range 0 33
        default 23
    config KLIVOX_LED_BRIGHTNESS
        int "Initial logical brightness (0-255)"
        range 0 255
        default 16
    config KLIVOX_LED_HIDE_ONLINE
        bool "Turn LED off when ONLINE"
        default n
endmenu
```

## components/temperature_manager/Kconfig
```kconfig
menu "Klivox temperature sensor"

    config KLIVOX_TEMPERATURE_GPIO
        int "DS18B20 1-Wire GPIO"
        range 0 48
        default 18
        help
            Use an available input/output GPIO, with an external 4.7 kOhm
            pull-up to 3.3 V. GPIO18 is the default for Klivox Wired ESP32.
            Select a suitable GPIO when reusing this component on another board.

    config KLIVOX_TEMPERATURE_PERIOD_SECONDS
        int "Temperature sampling period (seconds)"
        range 1 3600
        default 5
        help
            Start a measurement every configured period. Conversion waits
            inside the sensor task, without blocking app_main or event callbacks.

endmenu
```

## components/wifi_manager/Kconfig
```kconfig
menu "Klivox Wi-Fi manager configuration"

    choice EXAMPLE_PROV_TRANSPORT
        bool "Provisioning Transport"
        default EXAMPLE_PROV_TRANSPORT_SOFTAP if IDF_TARGET_ESP32S2
        default EXAMPLE_PROV_TRANSPORT_BLE
        help
            Wi-Fi provisioning component offers both, SoftAP and BLE transports. Choose any one.

        config EXAMPLE_PROV_TRANSPORT_BLE
            bool "BLE"
            select BT_ENABLED
            depends on !IDF_TARGET_ESP32S2
        config EXAMPLE_PROV_TRANSPORT_SOFTAP
            bool "Soft AP"
            select LWIP_IPV4
    endchoice

    choice EXAMPLE_PROV_SECURITY_VERSION
        bool "Protocomm security version"
        default EXAMPLE_PROV_SECURITY_VERSION_2
        help
            Wi-Fi provisioning component offers 3 security versions.
            The example offers a choice between security version 1 and 2.

        config EXAMPLE_PROV_SECURITY_VERSION_1
            bool "Security version 1"
            select ESP_PROTOCOMM_SUPPORT_SECURITY_VERSION_1

        config EXAMPLE_PROV_SECURITY_VERSION_2
            bool "Security version 2"
            select ESP_PROTOCOMM_SUPPORT_SECURITY_VERSION_2
    endchoice

    choice EXAMPLE_PROV_MODE
        bool "Security version 2 mode"
        depends on EXAMPLE_PROV_SECURITY_VERSION_2
        default EXAMPLE_PROV_SEC2_DEV_MODE

        config EXAMPLE_PROV_SEC2_DEV_MODE
            bool "Security version 2 development mode"
            depends on EXAMPLE_PROV_SECURITY_VERSION_2
            help
                This enables the development mode for
                security version 2.
                Please note that this mode is NOT recommended for production purpose.

        config EXAMPLE_PROV_SEC2_PROD_MODE
            bool "Security version 2 production mode"
            depends on EXAMPLE_PROV_SECURITY_VERSION_2
            help
                This enables the production mode for
                security version 2.
    endchoice

    config EXAMPLE_PROV_TRANSPORT
        int
        default 1 if EXAMPLE_PROV_TRANSPORT_BLE
        default 2 if EXAMPLE_PROV_TRANSPORT_SOFTAP

    config EXAMPLE_PROV_ENABLE_APP_CALLBACK
        bool "Enable provisioning manager app callback"
        default n
        help
            This is for advanced use-cases like modifying Wi-Fi configuration parameters. This
            executes a blocking app callback when any provisioning event is triggered.

    config EXAMPLE_RESET_PROV_MGR_ON_FAILURE
        bool
        default y
        prompt "Allow retry of failed initial provisioning"
        help
            Only while initial provisioning is active, discard the newly rejected
            credentials and let the phone submit corrected credentials.
            Never used for an already validated connection or a normal disconnection.

    config EXAMPLE_PROV_MGR_CONNECTION_CNT
        int
        default 5
        range 1 20
        prompt "Max connection attempts before resetting provisioning state machine"
        depends on EXAMPLE_RESET_PROV_MGR_ON_FAILURE
        help
            Attempts to validate newly received credentials. On failure, only
            those unvalidated credentials are discarded so the phone can retry.
            Saved credentials from a normal boot are never reset by this option.

    config KLIVOX_WIFI_RETRY_INITIAL_MS
        int "Initial Wi-Fi reconnect delay (milliseconds)"
        range 1000 30000
        default 1000

    config KLIVOX_WIFI_RETRY_MAX_MS
        int "Maximum Wi-Fi reconnect delay (milliseconds)"
        range 30000 300000
        default 60000
        help
            Reconnection uses a one-shot timer and exponential backoff.
            Initial provisioning connection attempts remain owned by ESP-IDF.

    config EXAMPLE_PROV_SHOW_QR
        bool "Show provisioning QR code"
        default y
        help
            Show the QR code for provisioning.

    config EXAMPLE_PROV_USING_BLUEDROID
        bool
        depends on (BT_BLUEDROID_ENABLED && (IDF_TARGET_ESP32C3 || IDF_TARGET_ESP32S3))
        select BT_BLE_42_FEATURES_SUPPORTED
        default y
        help
            This enables BLE 4.2 features for Bluedroid.

endmenu
```
